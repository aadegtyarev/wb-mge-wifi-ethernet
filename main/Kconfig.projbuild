## main/Kconfig.projbuild
```kconfig
menu "WB-MGE bridge"
    config EXAMPLE_RECONFIGURE_BUTTON
        int "Config button GPIO"
        range 0 39
        default 34
endmenu
```

## sdkconfig.defaults
```kconfig
CONFIG_IDF_TARGET="esp32"
CONFIG_ESPTOOLPY_FLASHSIZE_4MB=y
CONFIG_EXAMPLE_ETH_PHY_RTL8201=y
CONFIG_EXAMPLE_ETH_MDC_GPIO=23
CONFIG_EXAMPLE_ETH_MDIO_GPIO=18
CONFIG_EXAMPLE_ETH_PHY_RST_GPIO=5
CONFIG_EXAMPLE_ETH_PHY_ADDR=0
CONFIG_EXAMPLE_RECONFIGURE_BUTTON=34
```
